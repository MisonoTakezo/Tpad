## boards/shields/tballpad/Kconfig.defconfig
```kconfig
if SHIELD_TBALLPAD_RIGHT

config ZMK_KEYBOARD_NAME
    default "tballpad"

endif

if SHIELD_TBALLPAD_LEFT || SHIELD_TBALLPAD_RIGHT

config ZMK_SPLIT
    default y

endif
```

## boards/shields/tballpad/Kconfig.shield
```kconfig
config SHIELD_TBALLPAD_LEFT
    def_bool $(shields_list_contains,tballpad_left)
config SHIELD_TBALLPAD_RIGHT
    def_bool $(shields_list_contains,tballpad_right)
```

## config/west.yml
```yaml
manifest:
  remotes:
    - name: zmkfirmware
      url-base: https://github.com/zmkfirmware
    - name: sekigon-gonnoc
      url-base: https://github.com/sekigon-gonnoc
    - name: takezo
      url-base: https://github.com/MisonoTakezo
  projects:
    - name: zmk
      remote: zmkfirmware
      revision: main
      import: app/west.yml
    - name: zmk-driver-paw3222
      remote: sekigon-gonnoc
      revision: main
    - name: zmk-driver-iqs7211e
      remote: sekigon-gonnoc
  self:
    path: config
```
